## conf/layer.conf
```bitbake
# We have a conf and classes directory, add to BBPATH
BBPATH .= ":${LAYERDIR}"

# We have a packages directory, add to BBFILES
BBFILES += "${LAYERDIR}/recipes-*/*/*.bb \
            ${LAYERDIR}/recipes-*/*/*.bbappend"

BBFILE_COLLECTIONS += "roj"
BBFILE_PATTERN_roj := "^${LAYERDIR}/"
BBFILE_PRIORITY_roj = "10"
```

## conf/machine/mx6qroj.conf
```bitbake
#@TYPE: Machine
#@NAME: Freescale i.MX6Q ROJ SMARC
#@SOC: i.MX6Q
#@DESCRIPTION: Machine configuration for Roj i.MX6Q SMARC
#@MAINTAINER: Daiane Angolini <daiane.angolini@freescale.com>

require conf/machine/include/mx6qroj-common.inc

SOC_FAMILY = "mx6:mx6q"

KERNEL_DEVICETREE = "imx6q-roj.dtb "

UBOOT_CONFIG ??= "sd"
UBOOT_CONFIG[sd] = "mx6qroj_config,sdcard"
UBOOT_CONFIG[eimnor] = "mx6qroj_eimnor_config"
UBOOT_CONFIG[nand] = "mx6qroj_nand_config,ubifs"
UBOOT_CONFIG[spinor] = "mx6qroj_spinor_config"
UBOOT_CONFIG[sata] = "mx6qroj_sata_config"
UBOOT_CONFIG[mfgtool] = "mx6qroj_config"
```
